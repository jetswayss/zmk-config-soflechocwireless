## config/west.yml
```yaml
manifest:
  remotes:
    - name: zmkfirmware
      url-base: https://github.com/zmkfirmware
    - name: jack
      url-base: https://github.com/jetswayss
  projects:
    - name: zmk
      remote: jack
      revision: mouse
      import: app/west.yml
  self:
    path: config
```
